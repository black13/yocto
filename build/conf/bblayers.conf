## build/conf/bblayers.conf
```bitbake
# POKY_BBLAYERS_CONF_VERSION is increased each time build/conf/bblayers.conf
# changes incompatibly
POKY_BBLAYERS_CONF_VERSION = "2"

BBPATH = "${TOPDIR}"
BBFILES ?= ""

BBLAYERS ?= " \
  /data_container/poky-rocko-18.0.0/meta \
  /data_container/poky-rocko-18.0.0/meta-poky \
  /data_container/poky-rocko-18.0.0/meta-yocto-bsp \
	/data_container/poky-rocko-18.0.0/meta-hello \
"
```
